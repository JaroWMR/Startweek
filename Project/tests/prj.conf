## CMakeLists.txt
```
# The following code is stolen from: samples/subsys/testsuite/integration
# SPDX-License-Identifier: Apache-2.0

cmake_minimum_required(VERSION 3.20.0)
find_package(Zephyr REQUIRED HINTS $ENV{ZEPHYR_BASE})
project(startweek)

FILE(GLOB app_sources src/*.c)
file(GLOB SRC_ACTUATORS_SOURCES "../src/actuators/*.c")
file(GLOB SRC_MINIGAMES_SOURCES "../src/minigames/*.c")
file(GLOB SRC_SENSORS_SOURCES 	"../src/sensors/*.c")
target_sources(app PRIVATE
	${app_sources}
	${SRC_ACTUATORS_SOURCES}
	${SRC_MINIGAMES_SOURCES}
	${SRC_SENSORS_SOURCES}
	../src/walking.c
	../src/statemachine.c
)

target_include_directories(app PRIVATE
	${CMAKE_CURRENT_SOURCE_DIR}/../inc
)
```

## prj.conf
```kconfig
CONFIG_GPIO=y
CONFIG_DEBUG_OPTIMIZATIONS=y
CONFIG_SIZE_OPTIMIZATIONS=n
CONFIG_SPEED_OPTIMIZATIONS=n
CONFIG_ENTROPY_GENERATOR=y
CONFIG_ZTEST=y
```

## src/main.c
```c
#include <zephyr/ztest.h>
#include "threads.h"
#include <stdio.h>
#include <stdint.h>
#include "config.h"

void test_main(void)
{
	disableAllThreads();

	ztest_run_all(NULL, false, 1, 1);

	ztest_verify_all_test_suites_ran();
}
```

## inc/config.h
```c
// #define LED_MATRIX
// #define BUTTON_MATRIX
// #define CIRCLE_MATRIX
// #define GENERIC_GPIO
// #define LCD
// #define SEVEN_SEGMENT
#define INTEGRATION

#include "testIntegration.h"
// #include "testLedMatrix.h"
// #include "testButtonMatrix.h"
// #include "testCircleMatrix.h"
// #include "testGenericGpio.h"
// #include "testLcd.h"
// #include "testSevenSegment.h"
```

## inc/testButtonMatrix.h
```c
#include <zephyr/ztest.h>
#include "buttonMatrix.h"
```

## inc/testCircleMatrix.h
```c
#include <zephyr/ztest.h>
#include "circleMatrix.h"
```

## inc/testGenericGpio.h
```c
#include <zephyr/ztest.h>
#include "genericGpio.h"
```

## inc/testIntegration.h
```c
#include <zephyr/ztest.h>
#include "threads.h"
#include "lcd.h"
#include "genericGpio.h"
```

## inc/testLcd.h
```c
#include <zephyr/ztest.h>
#include "lcd.h"
```

## inc/testLedMatrix.h
```c
#include <zephyr/ztest.h>
#include "ledMatrix.h"
```

## inc/testSevenSegment.h
```c
#include <zephyr/ztest.h>
#include "sevenSegment.h"
```

## src/testAccelerometer.c
```c
#include "testGyroCompass.h"

ZTEST_SUITE(testAccelerometer, NULL, NULL, NULL, NULL, NULL);
ZTEST_SUITE(testMagnetometer, NULL, NULL, NULL, NULL, NULL);
ZTEST_SUITE(testCompass, NULL, NULL, NULL, NULL, NULL);

ZTEST(testAccelerometer, test_name)
{
	// bool a =  buttonMatrixConfig();
	// zassert_equal(a,0);
}
```

## src/testButtonMatrix.c
```c
#include "testButtonMatrix.h"

ZTEST_SUITE(testButtonMatrix, NULL, NULL, NULL, NULL, NULL);

ZTEST(testButtonMatrix, test_Matrix_Config_one)
{
	bool a =  buttonMatrixConfig();
	zassert_equal(a,0);
}

ZTEST(testButtonMatrix, test_Matrix_Init_one)
{	
	int8_t a = buttonMatrixInit();
	zassert_equal(a,0);
}

ZTEST(testButtonMatrix, test_Matrix_Set_one)
{
	int8_t data[4] = {0b11111111, 0b11111111, 0b11111111, 0b11111111};
	int8_t a = buttonMatrixSet(data);
	zassert_equal(a,0);
}

ZTEST(testButtonMatrix, test_Buttons_Config_one)
{
	bool a =  buttons4x4Config();
	zassert_equal(a,0);
}

ZTEST(testButtonMatrix, test_Buttons_Init_one)
{	
	int8_t a = buttons4x4Init();
	zassert_equal(a,0);
}

ZTEST(testButtonMatrix, test_Buttons_Get_one)
{
	for(uint8_t i = 0; i < 16; i++)
	{
		uint8_t a = buttons4x4Get(i);
		zassert_equal(a,1);
	}
}
```

## src/testCircleMatrix.c
```c
#include "testCircleMatrix.h"

ZTEST_SUITE(testCircleMatrix, NULL, NULL, NULL, NULL, NULL);

ZTEST(testCircleMatrix, test_Config_one)
{
	bool a =  circleMatrixConfig();
	zassert_equal(a,0);
}

ZTEST(testCircleMatrix, test_Init_one)
{	
	int8_t a = circleMatrixInit();
	zassert_equal(a,0);
}

ZTEST(testCircleMatrix, test_Set_one)
{
	int8_t data[8] = 	{0b11111111, 0b11111111, 0b11111111, 0b11111111, 
						0b11111111, 0b11111111, 0b11111111, 0b11111111,
						};
	int8_t a = circleMatrixSet(data);
	zassert_equal(a,0);
}
```

## src/testGenericGpio.c
```c
#include "testGenericGpio.h"

int8_t a = 0;
ZTEST_SUITE(testGenericGpio, NULL, NULL, NULL, NULL, NULL);

ZTEST(testGenericGpio, test_Switch_Config_one)
{
	a =  switchesConfig();
	zassert_equal(a,0);
}

ZTEST(testGenericGpio, test_Switch_Init_one)
{	
	a = switchesInit();
	zassert_equal(a,0);
}

ZTEST(testGenericGpio, test_Switch_Get_one)
{

	for(uint8_t i = 0; i < 5; i++)
	{
		a = switchesGet(i);
		zassert_equal(a,0);
	}
}


ZTEST(testGenericGpio, test_abc_Config_one)
{
	a = abcbuttonsConfig();
	zassert_equal(a,0);
	a = abcledsConfig();
	zassert_equal(a,0);
}

ZTEST(testGenericGpio, test_abc_Init_one)
{	
	a = abcbuttonsInit();
	zassert_equal(a,0);
	a = abcledsInit();
	zassert_equal(a,0);
}

ZTEST(testGenericGpio, test_abc_GetSet_one)
{

	a = abcbuttonsGet('a');
	zassert_equal(a,0);
	a = abcledsSet('a',0);
	zassert_equal(a,0);

	a = abcbuttonsGet('b');
	zassert_equal(a,0);
	a = abcledsSet('b',0);
	zassert_equal(a,0);

	a = abcbuttonsGet('c');
	zassert_equal(a,0);
	a = abcledsSet('c',0);
	zassert_equal(a,0);
}



ZTEST(testGenericGpio, test_start_Config_one)
{
	a = startbuttonledConfig();
	zassert_equal(a,0);
}

ZTEST(testGenericGpio, test_start_Init_one)
{	
	a = startbuttonledInit();
	zassert_equal(a,0);

}

ZTEST(testGenericGpio, test_start_GetSet_one)
{
	a = startbuttonGet();
	zassert_equal(a,0);
	a = startledSet(0);
	zassert_equal(a,0);
}
```
