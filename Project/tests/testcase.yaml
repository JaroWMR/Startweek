## Project/tests/testcase.yaml
```yaml
# The following code is stolen from: samples/subsys/testsuite/integration
tests:
  # section.subsection
  sample.testing.ztest:
    build_only: false # Changed this to false, was true
    platform_allow:
      - native_posix
      - native_sim
    integration_platforms:
      - native_sim
    tags: test_framework
```
